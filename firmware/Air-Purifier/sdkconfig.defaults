## firmware/Air-Purifier/sdkconfig.defaults
```kconfig
CONFIG_ESP_CONSOLE_USB_SERIAL_JTAG=y

# Enable BLE / NimBLE stack
CONFIG_BT_ENABLED=y
CONFIG_BT_NIMBLE_ENABLED=y
CONFIG_BT_CONTROLLER_ENABLED=y

# Disable classic Bluetooth (BLE only)
CONFIG_BT_CLASSIC_ENABLED=n
CONFIG_BT_BLUEDROID_ENABLED=n

CONFIG_ESPTOOLPY_FLASHSIZE_16MB=y
CONFIG_ESPTOOLPY_FLASHSIZE="16mb"
```
